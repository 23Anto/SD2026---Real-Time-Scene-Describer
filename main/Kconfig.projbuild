## main/Kconfig.projbuild
```kconfig
menu "Example Configuration"


    menu "I2S MEMS MIC Configuration"

        config EXAMPLE_SAMPLE_RATE
            int "Audio Sample Rate"
            default 44100 if SOC_I2S_SUPPORTS_PDM2PCM
            default 5644800
            help
                Set the audio sample rate frequency. Usually 16000 or 44100 Hz if PCM data format supported.
                Oversample rate usually can be 2048000 or 5644800 Hz if only raw PDM data format supported.

        config EXAMPLE_BIT_SAMPLE
            int "Audio Bit Sample"
            default 16
            help
                Define the number of bits for each sample. Default 16 bits per sample.

        config EXAMPLE_I2S_DATA_GPIO
            int "I2S Data GPIO"
            default 5
            help
                Set the GPIO number used for transmitting/receiving data from I2S.

        config EXAMPLE_I2S_CLK_GPIO
            int "I2S Clock GPIO"
            default 4
            help
                Set the GPIO number used for the clock line from I2S.

    endmenu

endmenu
```
